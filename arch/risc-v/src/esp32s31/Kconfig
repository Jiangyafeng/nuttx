## arch/risc-v/src/esp32s31/Kconfig
```kconfig
#
# For a description of the syntax of this configuration file,
# see the file kconfig-language.txt in the NuttX tools repository.
#

if ARCH_CHIP_ESP32S31

comment "ESP32-S31 Configuration Options"

source "arch/risc-v/src/common/espressif/Kconfig"

config ESP32S31_SMP
	bool "Enable the ESP32-S31 two-core NuttX SMP port"
	depends on SMP
	depends on SMP_NCPUS = 2
	depends on ARCH_USE_S_MODE
	depends on ESPRESSIF_SIMPLE_BOOT
	depends on BUILD_KERNEL
	help
		Start CPU1 through the ESP32-S31 per-hart M-mode monitor, release it
		from nx_smp_start(), and use the S31 cross-core interrupt sources for
		NuttX reschedule and SMP-call delivery.  Production enables this with
		CONFIG_SMP_DEFAULT_CPUSET covering both harts.

config ESP32S31_SMP_TLB_SHOOTDOWN
	bool "Cross-core TLB shootdown for address environments"
	default y
	depends on ESP32S31_SMP
	depends on ARCH_ADDRENV
	select ARCH_RV_TLB_SHOOTDOWN
	help
		After a mapping, unmapping, permission change, or address-environment
		destroy, invalidate remote-hart TLB entries with a generation/ack
		mailbox delivered over the existing SMP IPI.  Required so heap grow,
		pthread stacks, and App exit stay coherent when the same Sv32 addrenv
		is active on more than one CPU.

config ESP32S31_SMP_TLB_SHOOTDOWN_TIMEOUT_US
	int "TLB shootdown acknowledgement timeout (microseconds)"
	depends on ESP32S31_SMP_TLB_SHOOTDOWN
	range 1000 5000000
	default 500000

config ESP32S31_CPU1_BOOT_TIMEOUT_US
	int "CPU1 bring-up handshake timeout (microseconds)"
	depends on ESP32S31_SMP
	range 1000 5000000
	default 500000

config ESP32S31_CPU1_BOOT_STACKSIZE
	int "CPU1 bring-up stack size"
	depends on ESP32S31_SMP
	range 256 4096
	default 1024

endif # ARCH_CHIP_ESP32S31
```

## binfmt/Kconfig
```kconfig
#
# For a description of the syntax of this configuration file,
# see the file kconfig-language.txt in the NuttX tools repository.
#

config BINFMT_DISABLE
	bool "Disable BINFMT support"
	default DEFAULT_SMALL
	---help---
		By default, support for loadable binary formats is built.  This logic
		may be suppressed by defining this setting.

if !BINFMT_DISABLE

config PATH_INITIAL
	string "Initial PATH Value"
	default ""
	depends on LIBC_ENVPATH
	---help---
		The initial value of the PATH variable.  This is the colon-separated
		list of absolute paths.  E.g., "/bin:/usr/bin:/sbin"

config BINFMT_LOADABLE
	bool
	select MODULES
	default n
	---help---
		Automatically selected if a loadable binary format is selected.

config PIC
	bool "Executable elf position-independent support"
	default n
	---help---
		Automatically selected if the binary format requires position
		independent operation.

config NXFLAT
	bool "Enable the NXFLAT Binary Format"
	default n
	select BINFMT_LOADABLE
	select PIC
	---help---
		Enable support for the NXFLAT binary format.  Default: n

if NXFLAT
source "binfmt/libnxflat/Kconfig"
endif

config ELF
	bool "Enable the ELF Binary Format"
	default n
	select BINFMT_LOADABLE
	select LIBC_ELF
	---help---
		Enable support for the ELF binary format.  Default: n

if ELF
config ELF_STACKSIZE
	int "ELF Stack Size"
	default DEFAULT_TASK_STACKSIZE
	---help---
		This is the default stack size that will be used when starting ELF binaries.

config ELF_APP_VERIFY
	bool "Verify ET_EXEC application integrity before loading"
	default n
	depends on ARCH_ADDRENV && BINFMT_ELF_EXECUTABLE
	select CRYPTO
	---help---
		Require a hexadecimal SHA-256 sidecar named <application>.sha256 and
		validate file length, ELF tables, PT_LOAD boundaries, W^X policy and
		the configured text/data address-environment windows before allocating
		any application pages.

config ELF_APP_MAX_FILESIZE
	int "Maximum verified ELF application file size"
	default 262144
	depends on ELF_APP_VERIFY
	range 4096 16777216
endif
endif

config BINFMT_CONSTRUCTORS
	bool "C++ Static Constructor Support"
	default n
	depends on HAVE_CXX && ELF
	---help---
		Built-in support for C++ constructors in loaded modules.  Currently
		only support for ELF binary formats.

choice
	prompt "File output format"
	default BINFMT_ELF_RELOCATABLE
	---help---
		Defines the type of ELF file produced by the NuttX build system.

config BINFMT_ELF_RELOCATABLE
	bool "Relocatable ELF"
	---help---
		Produce a relocatable object as output. This is also known as partial linking.

config BINFMT_ELF_EXECUTABLE
	bool "Executable ELF"
	depends on ARCH_HAVE_ELF_EXECUTABLE
	---help---
		Produce a full linked executable object as output.

endchoice

config BINFMT_STORE_FILENAME
	bool "Store the binary filename"
	default n
	---help---
		Store the filename of the loaded binary
```

## boards/risc-v/esp32s31/esp32s31-core-function-board/Kconfig
```kconfig
#
# For a description of the syntax of this configuration file,
# see the file kconfig-language.txt in the NuttX tools repository.
#

if ARCH_BOARD_ESP32S31_CORE_FUNCTION_BOARD

config ESP32S31_SMP_TEST
	bool "Run the G.2.0 cross-core scheduler boot diagnostic"
	depends on ESP32S31_SMP
	default n
	---help---
		Run the bounded CPU0-to-CPU1 and CPU1-to-CPU0 semaphore wakeup
		diagnostic during board bring-up.  This is retained by the cpu1-smp
		regression profile but omitted from normal production boots.

config ESP32S31_SMP_TEST_ROUNDS
	int "G.2.0 cross-core scheduler test rounds"
	depends on ESP32S31_SMP_TEST
	default 64
	range 1 1024
	---help---
		Number of bounded CPU0-to-CPU1 and CPU1-to-CPU0 semaphore wakeup
		rounds executed by the G.2.0 SMP diagnostic.

config ESP32S31_FLASH_APPFS
	bool "Load Kernel Build applications from SPI Flash AppFS"
	depends on BUILD_KERNEL
	select ESPRESSIF_SPIFLASH
	select ESPRESSIF_MTD
	select FS_ROMFS
	select FS_LITTLEFS
	---help---
		Generate a read-only seed image from the separately linked Kernel
		Build applications and place it outside the NuttX image.  The first
		part of the configured MTD region is mounted at /system/bin as ROMFS;
		the remainder is a writable, power-loss-resilient LittleFS mounted at
		/apps.  No application bytes are embedded in internal SRAM.

if ESP32S31_FLASH_APPFS

config ESP32S31_FLASH_APPFS_SEED_SIZE
	hex "Read-only AppFS seed partition size"
	default 0x100000
	---help---
		Size of the ROMFS seed partition at the beginning of the configured
		application MTD region.  The remaining bytes are used by LittleFS.

config ESP32S31_FLASH_APPFS_SEED_INSTALL
	bool "Install sv32test into writable AppFS on first boot"
	depends on EXAMPLES_SV32TEST
	default y
	---help---
		Atomically copy sv32test and its SHA-256 manifest from /system/bin to
		/apps when the writable copy is absent.

config ESP32S31_FLASH_APPFS_E0_CORPUS
	bool "Include E.0 malformed-ELF validation corpus"
	default n
	---help---
		Include the large oversize and malformed sv32test images used by the
		E.0 loader validation.  Later stage images can omit this corpus while
		retaining the normal sv32test regression application.

endif

endif # ARCH_BOARD_ESP32S31_CORE_FUNCTION_BOARD
```
